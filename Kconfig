## Kconfig
```kconfig
# Copyright (c) 2024 The ZMK Contributors
# SPDX-License-Identifier: MIT

config SPLIT_CS36_TB_TRACKBALL
	bool "Advanced Trackball Controller for split-cs36-tb"
	depends on !ZMK_SPLIT || ZMK_SPLIT_ROLE_CENTRAL
	default y
	help
	  Enable advanced trackball subsystem (acceleration, dynamic speed, rotation, automouse, momentary scroll, NVS).

menuconfig PAW3222
	bool "PAW3222 mouse optical sensor"
	select SPI
	help
	  Enable PAW3222 mouse optical sensor.
```

## boards/shields/split_cs36_tb/Kconfig.defconfig
```kconfig
if SHIELD_SPLIT_CS36_TB_RIGHT

config ZMK_KEYBOARD_NAME
    default "split_cs36_tb"

endif

if SHIELD_SPLIT_CS36_TB_LEFT || SHIELD_SPLIT_CS36_TB_RIGHT

config ZMK_SPLIT
    default y

endif
```

## boards/shields/split_cs36_tb/Kconfig.shield
```kconfig
config SHIELD_SPLIT_CS36_TB_LEFT
    def_bool $(shields_list_contains,split_cs36_tb_left)
config SHIELD_SPLIT_CS36_TB_RIGHT
    def_bool $(shields_list_contains,split_cs36_tb_right)
```

## config/west.yml
```yaml
manifest:
  remotes:
    - name: zmkfirmware
      url-base: https://github.com/zmkfirmware
    - name: sekigon-gonnoc
      url-base: https://github.com/sekigon-gonnoc
    - name: kot149
      url-base: https://github.com/kot149
    - name: prospector
      url-base: https://github.com/t-ogura
  projects:
    - name: zmk
      remote: zmkfirmware
      revision: v0.3
      import: app/west.yml
    - name: prospector-zmk-module
      remote: prospector
      revision: v2.2b
      path: modules/prospector-zmk-module
  self:
    path: config
```
